## components/display_hal/Kconfig.projbuild
```kconfig
menu "Hardware Display Selection"

    choice HARDWARE_BOARD
        prompt "Select Hardware Board"
        default HARDWARE_BOARD_WAVESHARE_S3 if IDF_TARGET_ESP32S3
        default HARDWARE_BOARD_WAVESHARE_P4 if IDF_TARGET_ESP32P4
        default HARDWARE_BOARD_WAVESHARE_S3

        config HARDWARE_BOARD_WAVESHARE_S3
            bool "Waveshare ESP32-S3 Touch LCD 4.3"
            depends on IDF_TARGET_ESP32S3
            help
                Selects the original Waveshare ESP32-S3 Touch LCD 4.3 board.
                Note: This requires setting the target to esp32s3 first.

        config HARDWARE_BOARD_WAVESHARE_P4
            bool "Waveshare ESP32-P4 WIFI6 Touch LCD 4.3"
            depends on IDF_TARGET_ESP32P4
            help
                Selects the Waveshare ESP32-P4 WIFI6 Touch LCD 4.3 board.
                Note: This requires setting the target to esp32p4 first.

    endchoice

endmenu
```

## main/Kconfig.projbuild
```kconfig
menu "WiFi Configuration"

    config WIFI_DEFAULT_SSID
        string "Default WiFi SSID (for development)"
        default ""
        help
            If the device's NVS memory is wiped, it will attempt to connect to this SSID automatically,
            bypassing the need to provision it via the WebUI on every re-flash. 
            WARNING: Will be saved in plaintext in sdkconfig!

    config WIFI_DEFAULT_PASSWORD
        string "Default WiFi Password"
        default ""
        help
            The password for the default WiFi SSID.

endmenu

menu "OpenLCB Node Configuration"

    config OPENLCB_NODE_ID
        hex "OpenLCB Node ID (48-bit)"
        default 0x05010101A604
        help
            The 48-bit (6 byte) globally unique Node ID for this device.
            This value must be unique for every physical node on your layout.

endmenu
```

## sdkconfig.defaults
```kconfig
# CPU Frequency (240MHz for maximum graphics processing speed)
CONFIG_ESP_DEFAULT_CPU_FREQ_MHZ_240=y
CONFIG_ESP_DEFAULT_CPU_FREQ_MHZ=240
CONFIG_ESP32S3_DEFAULT_CPU_FREQ_240=y
CONFIG_ESP32S3_DEFAULT_CPU_FREQ_MHZ=240

# Flash and PSRAM Speeds (80MHz - Stable & Supported for Mixed Modes)
CONFIG_ESPTOOLPY_FLASHFREQ_80M=y
CONFIG_ESPTOOLPY_FLASHFREQ="80m"
CONFIG_SPIRAM_SPEED_80M=y

# Flash Size Configuration (Match 16MB onboard hardware)
CONFIG_ESPTOOLPY_FLASHSIZE_16MB=y
CONFIG_ESPTOOLPY_FLASHSIZE="16MB"


# PSRAM (SPIRAM) Configuration
CONFIG_SPIRAM=y
CONFIG_SPIRAM_BOOT_INIT=y
CONFIG_SPIRAM_MODE_OCT=y
CONFIG_SPIRAM_USE_MALLOC=y
CONFIG_SPIRAM_MALLOC_ALWAYSINTERNAL=16384
CONFIG_SPIRAM_MALLOC_RESERVE_INTERNAL=32768
# CONFIG_SPIRAM_ALLOW_STACK_EXTERNAL_MEMORY=y
CONFIG_FREERTOS_TASK_CREATE_ALLOW_EXT_MEM=y

# Bootloader Optimization
CONFIG_BOOTLOADER_COMPILER_OPTIMIZATION_SIZE=y

# LVGL Configuration
CONFIG_LV_USE_DEMO_WIDGETS=y
CONFIG_LVGL_PORT_TASK_STACK_SIZE_KB=16
CONFIG_LV_MEM_CUSTOM=y
CONFIG_LV_USE_CLIB_MALLOC=y
CONFIG_LV_USE_BUILTIN_MALLOC=n
CONFIG_LV_DISP_DEF_REFR_PERIOD=16
CONFIG_LV_DEF_REFR_PERIOD=15
CONFIG_LVGL_PORT_TASK_MIN_DELAY_MS=1

# Tearing Avoidance & Direct Mode (Saves drawing bandwidth on LVGL v8 & v9)
CONFIG_LVGL_PORT_AVOID_TEAR_ENABLE=y
CONFIG_LVGL_PORT_AVOID_TEAR_MODE_3=y
CONFIG_LVGL_PORT_AVOID_TEAR_MODE=3


# Allocate LVGL display buffer in PSRAM (SPIRAM) to avoid SRAM fragmentation crash
CONFIG_LVGL_PORT_BUF_PSRAM=y
CONFIG_LVGL_PORT_BUF_INTERNAL=n


# Compiler Optimization (Perf -O2)
CONFIG_COMPILER_OPTIMIZATION_PERF=y

# Use a larger partition table (1.5MB/2MB app partition) to prevent overflow
CONFIG_PARTITION_TABLE_SINGLE_APP_LARGE=y
CONFIG_PARTITION_TABLE_FILENAME="partitions_singleapp_large.csv"

CONFIG_LV_FONT_MONTSERRAT_12=y
CONFIG_LV_FONT_MONTSERRAT_16=y

# Fix RGB LCD Jitter / Tearing without VSYNC artifacts
CONFIG_LCD_RGB_BOUNCE_BUFFER_MODE=y
CONFIG_LCD_RGB_BOUNCE_BUFFER_HEIGHT=120
CONFIG_SPIRAM_FETCH_INSTRUCTIONS=y
CONFIG_SPIRAM_RODATA=y
```
