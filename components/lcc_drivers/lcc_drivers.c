/**
 * @file openlcb_drivers.c
 * @brief Hardware driver implementations for OLCB/LCC Drivers.
 *        Connect OpenLcbCLib to your CAN controller, timers, and
 *        platform resources.
 *
 * @copyright
 *   Copyright (c) <YEAR>, <YOUR NAME OR COMPANY>
 *   <YOUR LICENSE TEXT HERE>
 *
 * Generated by Node Wizard — https://github.com/JimKueneman/OpenLcbCLib
 */

#include "lcc_drivers.h"

#include <string.h>
#include <nvs_flash.h>
#include <nvs.h>
#include "esp_log.h"
#include "freertos/FreeRTOS.h"
#include "freertos/semphr.h"
#include "config_manager.h"


#define CONFIG_MEM_SIZE 1024


static SemaphoreHandle_t openlcb_mutex = NULL;
uint8_t config_memory_cache[CONFIG_MEM_SIZE] = {0};

static const char *TAG = "LCC_DRIVERS";

char current_user_name[64] = {0};
char current_user_desc[65] = {0};

void save_config_to_nvs(void) {
    nvs_handle_t my_handle;
    if (nvs_open("openlcb", NVS_READWRITE, &my_handle) == ESP_OK) {
        nvs_set_blob(my_handle, "config_mem", config_memory_cache, CONFIG_MEM_SIZE);
        nvs_commit(my_handle);
        nvs_close(my_handle);
        ESP_LOGI(TAG, "Config memory saved to NVS.");
    }
}



void save_strings_to_nvs(void) {
    nvs_handle_t my_handle;
    if (nvs_open("openlcb", NVS_READWRITE, &my_handle) == ESP_OK) {
        nvs_set_str(my_handle, "user_name", current_user_name);
        nvs_set_str(my_handle, "user_desc", current_user_desc);
        nvs_commit(my_handle);
        nvs_close(my_handle);
        ESP_LOGI("NVS", "Node strings saved to flash.");
    }
}

void init_node_storage(void) {

    nvs_handle_t my_handle;
    esp_err_t err = nvs_open("openlcb", NVS_READWRITE, &my_handle);
    if (err != ESP_OK) {
        ESP_LOGE(TAG, "Failed to open NVS namespace.");
        return;
    }

    size_t required_size = CONFIG_MEM_SIZE;
    err = nvs_get_blob(my_handle, "config_mem", config_memory_cache, &required_size);

    if (err != ESP_OK || required_size != CONFIG_MEM_SIZE) {
        // Not found on first boot: apply defaults and commit
        ESP_LOGI(TAG, "NVS config empty or layout size changed (%d -> %d). Upgrading...",
            (err==ESP_OK) ? (int)required_size : 0, CONFIG_MEM_SIZE);
        if (err == ESP_OK && required_size >= 127) {
            ESP_LOGI(TAG, "Preserving node name and description");
            memset(&config_memory_cache[127], 0, CONFIG_MEM_SIZE - 127);
        } else {
            memset(config_memory_cache, 0, CONFIG_MEM_SIZE);
            strncpy((char*)&config_memory_cache[0], DEFAULT_NODE_USER_NAME, 62);
            strncpy((char*)&config_memory_cache[63], DEFAULT_NODE_DESCRIPTION, 63);
        }

        // Push defaults to NVS
        nvs_set_blob(my_handle, "config_mem", config_memory_cache, CONFIG_MEM_SIZE);
        nvs_commit(my_handle);
    }
    nvs_close(my_handle);
    ESP_LOGI(TAG, "Loaded Node Name: %s", (char*)&config_memory_cache[0]);
}


void lcc_drivers_initialize(void) {
    init_node_storage();
    openlcb_mutex = xSemaphoreCreateMutex();
}


void lcc_drivers_lock_shared_resources(void) {
    if (openlcb_mutex != NULL) {
        xSemaphoreTake(openlcb_mutex, portMAX_DELAY);
    }
}


void lcc_drivers_unlock_shared_resources(void) {
    if (openlcb_mutex != NULL) {
        xSemaphoreGive(openlcb_mutex);
    }
}


 uint16_t lcc_drivers_config_mem_read(openlcb_node_t *openlcb_node, uint32_t address, uint16_t count,
  configuration_memory_buffer_t *buffer) {
        if (address + count > CONFIG_MEM_SIZE) {
            ESP_LOGE(TAG, "Read out of bounds! Addr: %lu, Count: %d", address, count);
            return 0;
        }

        uint8_t *buf = (uint8_t *)buffer;

        lcc_drivers_lock_shared_resources();
        
        // Sync FROM config manager to cache before read
        const lever_system_config_t *curr = config_manager_get_current();
        if (curr) {
            config_memory_cache[127] = curr->lcc_enabled ? 1 : 0;
            config_memory_cache[128] = curr->restore_last_state ? 1 : 0;
            config_memory_cache[129] = (uint8_t)curr->conflict_policy;
        }
        
        memcpy(buf, &config_memory_cache[address], count);
        lcc_drivers_unlock_shared_resources();

        return count;
    }

    uint16_t lcc_drivers_config_mem_write(openlcb_node_t *openlcb_node, uint32_t address, uint16_t count,
  configuration_memory_buffer_t *buffer) {
        if (address + count > CONFIG_MEM_SIZE) {
            ESP_LOGE(TAG, "Write out of bounds! Addr: %lu, Count: %d", address, count);
            return 0;
        }

        uint8_t *buf = (uint8_t *)buffer;
        bool memory_was_changed = false;

        lcc_drivers_lock_shared_resources();

        // Only flag a change if the new data is actually different
        if (memcmp(&config_memory_cache[address], buf, count) != 0) {
            memcpy(&config_memory_cache[address], buf, count);
            memory_was_changed = true;
        }

        lcc_drivers_unlock_shared_resources();

        if (memory_was_changed) {
            // Enforce null-terminators for safety if the user modified the strings
            config_memory_cache[62] = '\0';  // End of name (CDI size 63)
            config_memory_cache[126] = '\0'; // End of description (CDI size 64)

            save_config_to_nvs();
            
            // Sync TO config manager if the global settings were modified
            if (address <= 129 && (address + count) > 127) {
                config_manager_update_global_bool("lcc_enabled", config_memory_cache[127] != 0);
                config_manager_update_global_bool("restore_last_state", config_memory_cache[128] != 0);
                config_manager_update_global_int("conflict_policy", config_memory_cache[129]);
            }
        }

        return count;
    }


void lcc_drivers_reboot(openlcb_statemachine_info_t *statemachine_info, config_mem_operations_request_info_t *config_mem_operations_request_info) {

    // TODO: Implement reboot

}


void lcc_drivers_firmware_write(openlcb_statemachine_info_t *statemachine_info, config_mem_write_request_info_t *config_mem_write_request_info, write_result_t write_result) {

    // TODO: Implement firmware_write

}


void lcc_drivers_freeze(openlcb_statemachine_info_t *statemachine_info, config_mem_operations_request_info_t *config_mem_operations_request_info) {

    // TODO: Implement freeze

}


void lcc_drivers_unfreeze(openlcb_statemachine_info_t *statemachine_info, config_mem_operations_request_info_t *config_mem_operations_request_info) {

    // TODO: Implement unfreeze

}

node_config_memory_t* lcc_drivers_get_config(void) {
    return (node_config_memory_t*)config_memory_cache;
}

